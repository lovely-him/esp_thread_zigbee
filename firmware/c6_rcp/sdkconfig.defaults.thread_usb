## firmware/s3_boot/sdkconfig.defaults
```kconfig
CONFIG_PARTITION_TABLE_CUSTOM=y
CONFIG_PARTITION_TABLE_CUSTOM_FILENAME="../partitions_s3.csv"
CONFIG_PARTITION_TABLE_FILENAME="../partitions_s3.csv"
CONFIG_PARTITION_TABLE_OFFSET=0x8000
CONFIG_PARTITION_TABLE_MD5=y

CONFIG_ESPTOOLPY_FLASHSIZE_8MB=y
```

## firmware/s3_zigbee_gateway/sdkconfig.defaults
```kconfig
#
# Partition Table
#
CONFIG_PARTITION_TABLE_CUSTOM=y
CONFIG_PARTITION_TABLE_CUSTOM_FILENAME="../partitions_s3.csv"
CONFIG_PARTITION_TABLE_FILENAME="../partitions_s3.csv"
CONFIG_PARTITION_TABLE_OFFSET=0x8000
CONFIG_PARTITION_TABLE_MD5=y
# end of Partition Table

#
# Serial flasher config
#
CONFIG_ESPTOOLPY_FLASHSIZE_8MB=y
# end of Serial flasher config

#
# Event
#
CONFIG_ESP_SYSTEM_EVENT_TASK_STACK_SIZE=4096
#end of Event

#
# Zigbee
#
CONFIG_ZB_ENABLED=y
CONFIG_ZB_ZCZR=y
# end of Zigbee

#
# ESP Zigbee gateway rcp update
#
CONFIG_AUTO_UPDATE_RCP=n
# end of ESP Zigbee gateway rcp update
```

## firmware/s3_zigbee_gateway/sdkconfig.defaults.board
```kconfig
CONFIG_DEFAULT_PIN_TO_RCP_RESET=7
CONFIG_DEFAULT_PIN_TO_RCP_BOOT=8
CONFIG_DEFAULT_PIN_TO_RCP_TX=17
CONFIG_DEFAULT_PIN_TO_RCP_RX=18
CONFIG_ZB_GW_RCP_CHIP_ESP32H2=y
CONFIG_ESPTOOLPY_FLASHSIZE_8MB=y
```
